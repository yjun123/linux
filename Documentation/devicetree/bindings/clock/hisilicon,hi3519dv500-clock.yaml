## Documentation/devicetree/bindings/pinctrl/hisilicon,hi3519dv500-ioconfig.yaml
```yaml
# SPDX-License-Identifier: GPL-2.0-only OR BSD-2-Clause
%YAML 1.2
---
$id: http://devicetree.org/schemas/pinctrl/hisilicon,hi3519dv500-ioconfig.yaml#
$schema: http://devicetree.org/meta-schemas/core.yaml#

title: HiSilicon Hi3516DV500/Hi3519DV500 pin controller

maintainers:
  - Jun Yan <jerrysteve1101@gmail.com>

description: |
  The Hi3519DV500 pin control registers are spread over three register
  blocks (ioconfig0/1/2), each managing a disjoint set of pads.

  The Hi3516DV500 SoC is software compatible with the Hi3519DV500
  except for the upper part of the ioconfig2 block (offsets 0x48 to
  0xa4), whose pads expose the second MIPI RX input on the Hi3519DV500
  but plain GPIO13/GPIO14 functions on the Hi3516DV500.  The
  Hi3516DV500 therefore uses its own ioconfig2 compatible while
  reusing the Hi3519DV500 ioconfig0/1 compatibles.  Every pad
  owns a 32-bit IO config register with the following layout:

    bit  3:0  pin function select
    bit  7:4  drive strength level
    bit  9:8  pull control (encoding is domain specific)
    bit  10   slew rate (0 = fast, 1 = slow)

  Pads are grouped in IO domains which differ in the availability of
  pull and slew control and in the number of drive strength levels:

    EMMC_IO: combo pull (0x0 = off, 0x1 = down, 0x3 = up),
             drive levels 0..15, slew rate available
    IO2:     split pull (bit 9 = down, bit 8 = up),
             drive levels 0..3, slew rate available
    IO6:     combo pull, drive levels 0..7, slew rate available
    IO7_1:   no pull control, drive levels 0..3, no slew control
    IO7_2:   no pull control, drive levels 0..1, no slew control

  The drive-strength property takes the raw level index of the pad's IO
  domain; the datasheet does not provide a mA mapping for the levels.

properties:
  compatible:
    enum:
      - hisilicon,hi3516dv500-ioconfig2
      - hisilicon,hi3519dv500-ioconfig0
      - hisilicon,hi3519dv500-ioconfig1
      - hisilicon,hi3519dv500-ioconfig2

  reg:
    maxItems: 1

patternProperties:
  '-pins$':
    type: object
    additionalProperties: false
    allOf:
      - $ref: pincfg-node.yaml#
      - $ref: pinmux-node.yaml#

    properties:
      pinmux:
        description: |
          An array of pin mux settings, one entry per pad.  Each entry
          encodes the pad's IO config register offset within the block
          and the function number, using the HI3519DV500_PINMUX macro
          from include/dt-bindings/pinctrl/pinctrl-hi3519dv500.h.

      bias-disable: true

      bias-pull-up: true

      bias-pull-down: true

      drive-strength:
        description:
          Drive strength level index of the pad's IO domain.

      slew-rate:
        description:
          Slew rate control (0 = fast, 1 = slow).

    required:
      - pinmux

required:
  - compatible
  - reg

additionalProperties: false

examples:
  - |
    #include <dt-bindings/pinctrl/pinctrl-hi3519dv500.h>

    ioconfig@eff0000 {
        compatible = "hisilicon,hi3519dv500-ioconfig0";
        reg = <0x0eff0000 0x10000>;

        uart0-pins {
            pinmux = <HI3519DV500_PINMUX(0x054, 1)>,
                     <HI3519DV500_PINMUX(0x058, 1)>;
            bias-pull-up;
            drive-strength = <3>;
        };
    };
...
```

## Documentation/devicetree/bindings/pwm/hisilicon,hi3519dv500-pwm.yaml
```yaml
# SPDX-License-Identifier: GPL-2.0-only OR BSD-2-Clause
%YAML 1.2
---
$id: http://devicetree.org/schemas/pwm/hisilicon,hi3519dv500-pwm.yaml#
$schema: http://devicetree.org/meta-schemas/core.yaml#

title: HiSilicon Hi3519DV500 PWM controller

maintainers:
  - Jun Yan <jerrysteve1101@gmail.com>

description:
  The Hi3519DV500 SoC has three independent PWM controllers with six, six
  and five channels.  Every channel has a 32 bit period and duty cycle
  register at a 0x100 stride, and a control register with enable, polarity
  and clock prescaler fields.

allOf:
  - $ref: pwm.yaml#

properties:
  compatible:
    enum:
      - hisilicon,hi3519dv500-pwm0
      - hisilicon,hi3519dv500-pwm1
      - hisilicon,hi3519dv500-pwm2

  reg:
    maxItems: 1

  clocks:
    maxItems: 1

  resets:
    maxItems: 1

  "#pwm-cells":
    const: 3

required:
  - compatible
  - reg
  - clocks
  - resets
  - "#pwm-cells"

additionalProperties: false

examples:
  - |
    #include <dt-bindings/clock/hi3519dv500-clock.h>

    pwm0: pwm@11080000 {
        compatible = "hisilicon,hi3519dv500-pwm0";
        reg = <0x11080000 0x1000>;
        clocks = <&crg HI3519DV500_PWM0_CLK>;
        resets = <&crg 0x4588 0>;
        #pwm-cells = <3>;
    };
...
```

## Documentation/devicetree/bindings/rtc/hisilicon,hi3519dv500-rtc.yaml
```yaml
# SPDX-License-Identifier: GPL-2.0-only OR BSD-2-Clause
%YAML 1.2
---
$id: http://devicetree.org/schemas/rtc/hisilicon,hi3519dv500-rtc.yaml#
$schema: http://devicetree.org/meta-schemas/core.yaml#

title: HiSilicon Hi3519DV500 Real Time Clock

maintainers:
  - Jun Yan <jerrysteve1101@gmail.com>

description:
  The Hi3519DV500 SoC has an always-on RTC that keeps second, minute,
  hour and day counters, and can raise an interrupt when the counters
  match the programmed alarm value.

allOf:
  - $ref: rtc.yaml#

properties:
  compatible:
    const: hisilicon,hi3519dv500-rtc

  reg:
    maxItems: 1

  interrupts:
    maxItems: 1
    description: Alarm interrupt.

required:
  - compatible
  - reg
  - interrupts

unevaluatedProperties: false

examples:
  - |
    #include <dt-bindings/interrupt-controller/arm-gic.h>
    #include <dt-bindings/interrupt-controller/irq.h>

    rtc@11110000 {
        compatible = "hisilicon,hi3519dv500-rtc";
        reg = <0x11110000 0x10000>;
        interrupts = <GIC_SPI 49 IRQ_TYPE_LEVEL_HIGH>;
    };
...
```

## Documentation/devicetree/bindings/sound/everest,es7202.yaml
```yaml
# SPDX-License-Identifier: (GPL-2.0-only OR BSD-2-Clause)
%YAML 1.2
---
$id: http://devicetree.org/schemas/sound/everest,es7202.yaml#
$schema: http://devicetree.org/meta-schemas/core.yaml#

title: Everest ES7202 2 channel PDM analog to digital converter

maintainers:
  - Jun Yan <jerrysteve1101@gmail.com>

properties:
  compatible:
    enum:
      - everest,es7202

  reg:
    maxItems: 1

  reset-gpios:
    maxItems: 1
    description: GPIO connected to the reset pin (active high)

  power-supply:
    description: |
      Main supply (AVDD/DVDD). Optional; when omitted the driver assumes
      3.3 V. The supply voltage selects the analog front-end configuration
      (1.8 V vs 3.3 V).

  "#sound-dai-cells":
    const: 0

required:
  - compatible
  - reg
  - "#sound-dai-cells"

allOf:
  - $ref: dai-common.yaml#

unevaluatedProperties: false

examples:
  - |
    #include <dt-bindings/gpio/gpio.h>

    i2c {
        #address-cells = <1>;
        #size-cells = <0>;

        es7202: codec@30 {
            compatible = "everest,es7202";
            reg = <0x30>;
            #sound-dai-cells = <0>;
            reset-gpios = <&gpio0 0 GPIO_ACTIVE_HIGH>;
            power-supply = <&vcc3v3_sys>;
        };
    };
...
```

## Documentation/devicetree/bindings/spi/hisilicon,fmcv100-spi-flash.yaml
```yaml
# SPDX-License-Identifier: (GPL-2.0-only OR BSD-2-Clause)
%YAML 1.2
---
$id: http://devicetree.org/schemas/spi/hisilicon,fmcv100-spi-flash.yaml#
$schema: http://devicetree.org/meta-schemas/core.yaml#

title: HiSilicon FMCv100 serial flash controller

maintainers:
  - Jun Yan <jerrysteve1101@gmail.com>

description: |
  The FMCv100 flash controller of the HiSilicon Hi3519DV500 SoC talks
  to one flash die at a time in one of three mutually exclusive modes:
  SPI NOR, SPI NAND or raw NAND.  This binding describes the serial
  modes: the controller is driven as a spi-mem controller and serves
  either a SPI NOR chip ("jedec,spi-nor" child) or a SPI NAND chip
  with on-die ECC ("spi-nand" child).  The controller picks the flash
  type at probe time from the compatible of the child node, and a
  board wires and describes exactly one die.

allOf:
  - $ref: spi-controller.yaml#

properties:
  compatible:
    const: hisilicon,fmcv100-spi-flash

  reg:
    items:
      - description: control registers
      - description: memory window used as the data buffer

  reg-names:
    items:
      - const: control
      - const: memory

  clocks:
    maxItems: 1

required:
  - compatible
  - reg
  - reg-names
  - clocks

unevaluatedProperties: false

examples:
  - |
    #include <dt-bindings/clock/hi3519dv500-clock.h>

    spi@10000000 {
        compatible = "hisilicon,fmcv100-spi-flash";
        reg = <0x10000000 0x1000>, <0x0f000000 0x1000000>;
        reg-names = "control", "memory";
        clocks = <&crg HI3519DV500_FMC_CLK>;
        #address-cells = <1>;
        #size-cells = <0>;

        flash@0 {
            compatible = "jedec,spi-nor";
            reg = <0>;
            spi-max-frequency = <24000000>;
        };
    };
...
```

## Documentation/devicetree/bindings/usb/hisilicon,hi3519dv500-dwc3.yaml
```yaml
# SPDX-License-Identifier: (GPL-2.0-only OR BSD-2-Clause)
%YAML 1.2
---
$id: http://devicetree.org/schemas/usb/hisilicon,hi3519dv500-dwc3.yaml#
$schema: http://devicetree.org/meta-schemas/core.yaml#

title: HiSilicon Hi3519DV500 DWC3 USB SoC controller

maintainers:
  - Jun Yan <jerrysteve1101@gmail.com>

description: |
  The Hi3519DV500 embeds a Synopsys DWC3 USB IP core together with
  the controller glue logic in the peripheral control block.  The
  controller works in dual role mode: the role is switched through
  the generic USB role switch class, with no OTG ID or VBUS
  detection inputs available.

allOf:
  - $ref: snps,dwc3-common.yaml#
  - $ref: usb-drd.yaml#
  - $ref: usb.yaml#

properties:
  compatible:
    const: hisilicon,hi3519dv500-dwc3

  reg:
    items:
      - description: DWC3 core registers
      - description: peripheral control block used by the glue logic
      - description: USB pinout control register

  reg-names:
    items:
      - const: ctrl
      - const: peri
      - const: pinout

  interrupts:
    maxItems: 1

  clocks:
    items:
      - description: controller clock

  clock-names:
    const: ctrl-clk

  phys:
    items:
      - description: USB2 PHY
      - description: USB3 PHY

  phy-names:
    items:
      - const: usb2-phy
      - const: usb3-phy

required:
  - compatible
  - reg
  - reg-names
  - interrupts
  - clocks
  - clock-names
  - phys
  - phy-names

unevaluatedProperties: false

examples:
  - |
    usb@10320000 {
        compatible = "hisilicon,hi3519dv500-dwc3";
        reg = <0x10320000 0x10000>, <0x17a40000 0x5000>,
              <0x179f0010 0x4>;
        reg-names = "ctrl", "peri", "pinout";
        interrupts = <0 60 4>;
        clocks = <&crg 128>;
        clock-names = "ctrl-clk";
        phys = <&usb2phy0>, <&usb3phy0>;
        phy-names = "usb2-phy", "usb3-phy";
        dr_mode = "otg";
        usb-role-switch;
        role-switch-default-mode = "peripheral";
        maximum-speed = "super-speed";
        snps,tx-thr-num-pkt = /bits/ 8 <2>;
        snps,tx-max-burst = /bits/ 8 <8>;
        snps,rx-thr-num-pkt = /bits/ 8 <2>;
        snps,rx-max-burst = /bits/ 8 <4>;
    };
...
```

## drivers/pinctrl/hisilicon/Kconfig
```kconfig
# SPDX-License-Identifier: GPL-2.0-only

config PINCTRL_HI3519DV500
	tristate "HiSilicon Hi3519DV500 SoC pinctrl driver"
	depends on OF
	depends on ARCH_HISI || COMPILE_TEST
	select GENERIC_PINCTRL_GROUPS
	select GENERIC_PINMUX_FUNCTIONS
	select GENERIC_PINCONF
	help
	  Say Y to select the pinctrl driver for the HiSilicon Hi3516DV500
	  and Hi3519DV500 SoCs. The pin controller allows selecting the
	  mux function of each
	  pin and configuring its bias, drive strength and slew rate.
	  This driver can also be built as a module called
	  pinctrl-hi3519dv500.
```
