## Documentation/devicetree/bindings/mmc/snps,dwcmshc-sdhci.yaml
```yaml
# SPDX-License-Identifier: GPL-2.0-only
%YAML 1.2
---
$id: http://devicetree.org/schemas/mmc/snps,dwcmshc-sdhci.yaml#
$schema: http://devicetree.org/meta-schemas/core.yaml#

title: Synopsys Designware Mobile Storage Host Controller

maintainers:
  - Ulf Hansson <ulf.hansson@linaro.org>
  - Jisheng Zhang <Jisheng.Zhang@synaptics.com>

properties:
  compatible:
    oneOf:
      - items:
          - enum:
              - rockchip,rk3528-dwcmshc
              - rockchip,rk3562-dwcmshc
              - rockchip,rk3576-dwcmshc
          - const: rockchip,rk3588-dwcmshc
      - items:
          - const: sophgo,sg2044-dwcmshc
          - const: sophgo,sg2042-dwcmshc
      - enum:
          - canaan,k230-emmc
          - canaan,k230-sdio
          - hisilicon,hi3519dv500-dwcmshc
          - hpe,gsc-dwcmshc
          - rockchip,rk3568-dwcmshc
          - rockchip,rk3588-dwcmshc
          - snps,dwcmshc-sdhci
          - sophgo,cv1800b-dwcmshc
          - sophgo,sg2002-dwcmshc
          - sophgo,sg2042-dwcmshc
          - thead,th1520-dwcmshc
          - eswin,eic7700-dwcmshc

  reg:
    maxItems: 1

  interrupts:
    maxItems: 1

  clocks:
    minItems: 1
    maxItems: 5

  clock-names:
    minItems: 1
    maxItems: 5

  power-domains:
    maxItems: 1

  resets:
    minItems: 4
    maxItems: 5

  reset-names:
    minItems: 4
    maxItems: 5

  canaan,usb-phy:
    $ref: /schemas/types.yaml#/definitions/phandle
    description: Phandle to the Canaan K230 USB PHY node required for
                 k230-emmc/sdio.

  rockchip,txclk-tapnum:
    description: Specify the number of delay for tx sampling.
    $ref: /schemas/types.yaml#/definitions/uint8

  eswin,hsp-sp-csr:
    $ref: /schemas/types.yaml#/definitions/phandle-array
    items:
      - items:
          - description: Phandle to HSP(High-Speed Peripheral) device
          - description: Offset of the stability status register for internal
                         clock.
          - description: Offset of the stability register for host regulator
                         voltage.
    description:
      HSP CSR is to control and get status of different high-speed peripherals
      (such as Ethernet, USB, SATA, etc.) via register, which can tune
      board-level's parameters of PHY, etc.

  eswin,drive-impedance-ohms:
    description: Specifies the drive impedance in Ohm.
    enum: [33, 40, 50, 66, 100]

  hpe,gxp-sysreg:
    $ref: /schemas/types.yaml#/definitions/phandle-array
    items:
      - items:
          - description: phandle to HPE GXP SoC system register block (syscon)
          - description: offset of the MSHCCS register within the syscon block
    description:
      Phandle to the HPE GXP SoC system register block (syscon) and
      offset of the MSHCCS register used to configure clock
      synchronisation for HS200 tuning.

  hisilicon,crg-syscon:
    $ref: /schemas/types.yaml#/definitions/phandle
    description: Phandle to the CRG (clock and reset generator) syscon of the
                 Hi3519DV500 SoC, used to configure the controller clock mux,
                 sampling phases and DLL reference clock.

required:
  - compatible
  - reg
  - interrupts
  - clocks
  - clock-names

allOf:
  - $ref: mmc-controller.yaml#

  - if:
      properties:
        compatible:
          contains:
            enum:
              - canaan,k230-emmc
              - canaan,k230-sdio
    then:
      properties:
        clocks:
          minItems: 5
        clock-names:
          items:
            - const: core
            - const: bus
            - const: axi
            - const: block
            - const: timer
      required:
        - canaan,usb-phy

  - if:
      properties:
        compatible:
          contains:
            const: hpe,gsc-dwcmshc

    then:
      properties:
        clocks:
          items:
            - description: core clock
        clock-names:
          items:
            - const: core
      required:
        - hpe,gxp-sysreg
    else:
      properties:
        hpe,gxp-sysreg: false

  - if:
      properties:
        compatible:
          contains:
            const: sophgo,sg2042-dwcmshc

    then:
      properties:
        clocks:
          items:
            - description: core clock
            - description: bus clock
            - description: timer clock
        clock-names:
          items:
            - const: core
            - const: bus
            - const: timer
    else:
      properties:
        clocks:
          minItems: 1
          items:
            - description: core clock
            - description: bus clock for optional
            - description: axi clock for rockchip specified
            - description: block clock for rockchip specified
            - description: timer clock for rockchip specified
        clock-names:
          minItems: 1
          items:
            - const: core
            - const: bus
            - const: axi
            - const: block
            - const: timer

  - if:
      properties:
        compatible:
          contains:
            const: eswin,eic7700-dwcmshc
    then:
      properties:
        resets:
          minItems: 4
          maxItems: 4
        reset-names:
          items:
            - const: axi
            - const: phy
            - const: prstn
            - const: txrx
      required:
        - eswin,hsp-sp-csr
        - eswin,drive-impedance-ohms

  - if:
      properties:
        compatible:
          not:
            contains:
              enum:
                - eswin,eic7700-dwcmshc
                - hisilicon,hi3519dv500-dwcmshc
    then:
      properties:
        resets:
          minItems: 5
          maxItems: 5
        reset-names:
          items:
            - const: core
            - const: bus
            - const: axi
            - const: block
            - const: timer

  - if:
      properties:
        compatible:
          contains:
            const: hisilicon,hi3519dv500-dwcmshc
    then:
      properties:
        clocks:
          minItems: 1
          maxItems: 2
        clock-names:
          minItems: 1
          items:
            - const: core
            - const: bus
        resets:
          minItems: 4
          maxItems: 4
        reset-names:
          items:
            - const: crg_reset
            - const: crg_tx
            - const: crg_rx
            - const: dll_reset
      required:
        - hisilicon,crg-syscon
        - resets
        - reset-names
    else:
      properties:
        hisilicon,crg-syscon: false

  - if:
      properties:
        compatible:
          contains:
            const: rockchip,rk3576-dwcmshc

    then:
      required:
        - power-domains

unevaluatedProperties: false

examples:
  - |
    mmc@fe310000 {
      compatible = "rockchip,rk3568-dwcmshc";
      reg = <0xfe310000 0x10000>;
      interrupts = <0 25 0x4>;
      clocks = <&cru 17>, <&cru 18>, <&cru 19>, <&cru 20>, <&cru 21>;
      clock-names = "core", "bus", "axi", "block", "timer";
      bus-width = <8>;
      #address-cells = <1>;
      #size-cells = <0>;
    };
  - |
    mmc@aa0000 {
      compatible = "snps,dwcmshc-sdhci";
      reg = <0xaa000 0x1000>;
      interrupts = <0 25 0x4>;
      clocks = <&cru 17>, <&cru 18>;
      clock-names = "core", "bus";
      bus-width = <8>;
      #address-cells = <1>;
      #size-cells = <0>;
    };
  - |
    mmc@10020000 {
      compatible = "hisilicon,hi3519dv500-dwcmshc";
      reg = <0x10020000 0x1000>;
      interrupts = <0 50 0x4>;
      clocks = <&crg 97>, <&crg 98>;
      clock-names = "core", "bus";
      resets = <&crg 0x34c0 16>, <&crg 0x34c0 17>,
               <&crg 0x34c0 18>, <&crg 0x34c4 1>;
      reset-names = "crg_reset", "crg_tx", "crg_rx", "dll_reset";
      hisilicon,crg-syscon = <&crg>;
      bus-width = <8>;
      non-removable;
      no-sd;
      no-sdio;
      #address-cells = <1>;
      #size-cells = <0>;
    };

...
```

## Documentation/devicetree/bindings/net/hisilicon,gemac-mdio.yaml
```yaml
# SPDX-License-Identifier: (GPL-2.0-only OR BSD-2-Clause)
%YAML 1.2
---
$id: http://devicetree.org/schemas/net/hisilicon,gemac-mdio.yaml#
$schema: http://devicetree.org/meta-schemas/core.yaml#

title: HiSilicon GEMAC MDIO bus controller

maintainers:
  - Jun Yan <jerrysteve1101@gmail.com>

description: |
  The GEMAC MDIO bus controller is the MDIO master used by the
  HiSilicon GEMAC family Ethernet MACs to talk to the external PHY.
  It is instantiated as a separate platform device and may carry an
  external PHY reset line.

allOf:
  - $ref: mdio.yaml#

properties:
  compatible:
    const: hisilicon,gemac-mdio

  reg:
    maxItems: 1

  clocks:
    maxItems: 1
    description: the MDIO bus functional clock

  resets:
    maxItems: 1
    description: the external PHY reset line

  reset-names:
    const: phy_reset

required:
  - compatible
  - reg
  - clocks
  - resets
  - reset-names

unevaluatedProperties: false

examples:
  - |
    mdio@102903c0 {
            compatible = "hisilicon,gemac-mdio";
            reg = <0x102903c0 0x20>;
            clocks = <&crg 103>;
            resets = <&crg 0x37cc 0>;
            reset-names = "phy_reset";
            #address-cells = <1>;
            #size-cells = <0>;

            ethernet-phy@1 {
                    compatible = "ethernet-phy-id0141.0e90";
                    reg = <1>;
            };
    };
...
```

## Documentation/devicetree/bindings/net/hisilicon,gmac-v5.yaml
```yaml
# SPDX-License-Identifier: (GPL-2.0-only OR BSD-2-Clause)
%YAML 1.2
---
$id: http://devicetree.org/schemas/net/hisilicon,gmac-v5.yaml#
$schema: http://devicetree.org/meta-schemas/core.yaml#

title: HiSilicon GEMAC v5 Ethernet MAC

maintainers:
  - Jun Yan <jerrysteve1101@gmail.com>

description: |
  The GEMAC v5 is the fifth generation of the HiSilicon Gigabit
  Ethernet MAC.  It is found on several HiSilicon vision SoCs such as
  Hi3516DV500 and Hi3519DV500 and connects to an external PHY through
  a separate MDIO bus controller.  The controller supports the RGMII,
  MII and RMII PHY interface modes.

allOf:
  - $ref: ethernet-controller.yaml#

properties:
  compatible:
    const: hisilicon,gmac-v5

  reg:
    items:
      - description: MAC control register set
      - description: MAC interface control register (MACIF)

  reg-names:
    items:
      - const: control
      - const: macif

  interrupts:
    minItems: 4
    maxItems: 4
    description: |
      One interrupt per receive queue, in queue order.  The first
      interrupt also serves the transmit completion path, while the
      remaining three are the RSS receive queues.

  clocks:
    minItems: 1
    maxItems: 2
    description: |
      The MAC core clock is mandatory.  The MAC interface clock is
      optional and is only needed by the SoCs that gate it separately.

  clock-names:
    minItems: 1
    items:
      - const: gmac_clk
      - const: macif_clk

  resets:
    maxItems: 2

  reset-names:
    items:
      - const: port_reset
      - const: macif_reset

required:
  - compatible
  - reg
  - reg-names
  - interrupts
  - clocks
  - clock-names
  - resets
  - reset-names

unevaluatedProperties: false

examples:
  - |
    mdio@102903c0 {
            compatible = "hisilicon,gemac-mdio";
            reg = <0x102903c0 0x20>;
            clocks = <&crg 103>;
            resets = <&crg 0x37cc 0>;
            reset-names = "phy_reset";
            #address-cells = <1>;
            #size-cells = <0>;

            ethphy: ethernet-phy@1 {
                    compatible = "ethernet-phy-id0141.0e90";
                    reg = <1>;
            };
    };

    ethernet@10290000 {
            compatible = "hisilicon,gmac-v5";
            reg = <0x10290000 0x1000>, <0x1029300c 0x4>;
            reg-names = "control", "macif";
            interrupts = <0 54 4>, <0 55 4>, <0 56 4>, <0 57 4>;
            clocks = <&crg 103>, <&crg 104>;
            clock-names = "gmac_clk", "macif_clk";
            resets = <&crg 0x37c4 0>, <&crg 0x37c0 0>;
            reset-names = "port_reset", "macif_reset";
            phy-handle = <&ethphy>;
            phy-mode = "rgmii-id";
    };
...
```

## Documentation/devicetree/bindings/phy/hisilicon,hi3519dv500-usb-phy.yaml
```yaml
# SPDX-License-Identifier: (GPL-2.0-only OR BSD-2-Clause)
%YAML 1.2
---
$id: http://devicetree.org/schemas/phy/hisilicon,hi3519dv500-usb-phy.yaml#
$schema: http://devicetree.org/meta-schemas/core.yaml#

title: HiSilicon Hi3519DV500 USB PHY

maintainers:
  - Jun Yan <jerrysteve1101@gmail.com>

description: |
  The Hi3519DV500 provides one USB2 PHY and one USB3 combo PHY for
  the DWC3 USB controller.  The USB2 PHY carries the analog trim
  words from the device tree and from the OTP trim register, while
  the USB3 combo PHY runs a vendor defined eye diagram tuning
  sequence.  Both PHYs are powered through the CRG controller
  clock that also gates the PHY reset lines.

properties:
  compatible:
    enum:
      - hisilicon,hi3519dv500-usb2-phy
      - hisilicon,hi3519dv500-usb3-phy

  reg:
    minItems: 1
    maxItems: 2
    description: |
      The first region is the PHY register set.  The USB2 PHY has a
      second region for the OTP trim word register.

  reg-names:
    items:
      - const: phy
      - const: trim-otp

  clocks:
    items:
      - description: PHY clock from the CRG controller, which also
          gates the PHY reset lines

  hisilicon,u2phy-trim:
    $ref: /schemas/types.yaml#/definitions/uint32-array
    minItems: 2
    maxItems: 2
    description: |
      Two analog trim words for the USB2 PHY, written to the
      ANA_CFG0 and ANA_CFG2 registers before the reset line is
      released.

  '#phy-cells':
    const: 0

required:
  - compatible
  - reg
  - clocks
  - '#phy-cells'

if:
  properties:
    compatible:
      contains:
        const: hisilicon,hi3519dv500-usb2-phy

then:
  properties:
    reg:
      minItems: 2
      maxItems: 2
  required:
    - reg-names
    - hisilicon,u2phy-trim

else:
  properties:
    reg:
      maxItems: 1

unevaluatedProperties: false

examples:
  - |
    usb2phy: usb2-phy@17350000 {
        compatible = "hisilicon,hi3519dv500-usb2-phy";
        reg = <0x17350000 0x1000>, <0x101e0124 0x4>;
        reg-names = "phy", "trim-otp";
        clocks = <&crg 127>;
        hisilicon,u2phy-trim = <0x0a33c42b 0x0035180f>;
        #phy-cells = <0>;
    };

    usb3phy: usb3-phy@17361000 {
        compatible = "hisilicon,hi3519dv500-usb3-phy";
        reg = <0x17361000 0x1000>;
        clocks = <&crg 129>;
        #phy-cells = <0>;
    };
...
```

## Documentation/devicetree/bindings/phy/rockchip,rk3568-edp-phy.yaml
```yaml
# SPDX-License-Identifier: GPL-2.0
%YAML 1.2
---
$id: http://devicetree.org/schemas/phy/rockchip,rk3568-edp-phy.yaml#
$schema: http://devicetree.org/meta-schemas/core.yaml#

title: Rockchip RK3568 Naneng eDP Transmitter PHY

maintainers:
  - Heiko Stuebner <heiko@sntech.de>

properties:
  compatible:
    const: rockchip,rk3568-edp-phy

  clocks:
    maxItems: 1

  clock-names:
    const: refclk

  "#phy-cells":
    const: 0

required:
  - compatible
  - clocks
  - clock-names
  - "#phy-cells"

additionalProperties: false

examples:
  - |
    #include <dt-bindings/clock/rk3568-pmu-cru.h>
    edp-phy {
      compatible = "rockchip,rk3568-edp-phy";
      clocks = <&pmucru XIN_OSC0_EDPPHY_G>;
      clock-names = "refclk";
      #phy-cells = <0>;
    };
```
