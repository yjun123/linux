## Documentation/devicetree/bindings/clock/hisilicon,hi3519dv500-clock.yaml
```yaml
# SPDX-License-Identifier: (GPL-2.0-only OR BSD-2-Clause)
%YAML 1.2
---
$id: http://devicetree.org/schemas/clock/hisilicon,hi3519dv500-clock.yaml#
$schema: http://devicetree.org/meta-schemas/core.yaml#

title: Hisilicon SOC Clock for HI3519DV500

maintainers:
  - Dongjiu Geng <gengdongjiu@huawei.com>

description: |
  Hisilicon SOC clock control module which supports the clocks and
  resets on HI3519DV500.

  See also:
    dt-bindings/clock/hi3519dv500-clock.h

properties:
  compatible:
    oneOf:
      - const: hisilicon,hi3519dv500-clock
      - items:
          - const: hisilicon,hi3519dv500-clock
          - const: syscon

  reg:
    maxItems: 1

  '#clock-cells':
    const: 1

  '#reset-cells':
    const: 2
    description: |
      First cell is reset request register offset.
      Second cell is bit offset in reset request register.

required:
  - compatible
  - reg
  - '#clock-cells'
  - '#reset-cells'

additionalProperties: false

examples:
  - |
    clock-controller@11010000 {
        compatible = "hisilicon,hi3519dv500-clock";
        #clock-cells = <1>;
        #reset-cells = <2>;
        reg = <0x11010000 0x44a0>;
    };
...
```

## Documentation/devicetree/bindings/dma/hisilicon,hi3519dv500-edmacv310.yaml
```yaml
# SPDX-License-Identifier: (GPL-2.0-only OR BSD-2-Clause)
%YAML 1.2
---
$id: http://devicetree.org/schemas/dma/hisilicon,hi3519dv500-edmacv310.yaml#
$schema: http://devicetree.org/meta-schemas/core.yaml#

title: HiSilicon Hi3519DV500 EDMAC v310 DMA controller

maintainers:
  - Jun Yan <jerrysteve1101@gmail.com>

description: |
  The Hi3519DV500 embeds the EDMAC v310 DMA controller, the third
  generation of the HiSilicon EDMAC family.  The controller provides
  eight physical channels over a 64 bit AXI interface, serves up to
  32 peripheral request lines, and splits the channels into two
  classes: one pool dedicated to memory to memory transfers and one
  pool serving the peripheral slave requests, with the memory to
  memory class taking priority when a physical channel becomes free.

allOf:
  - $ref: dma-controller.yaml#

properties:
  compatible:
    const: hisilicon,hi3519dv500-edmacv310

  reg:
    maxItems: 1

  interrupts:
    maxItems: 1

  clocks:
    items:
      - description: APB interface clock
      - description: AXI interface clock

  clock-names:
    items:
      - const: apb_pclk
      - const: axi_aclk

  resets:
    maxItems: 1

  reset-names:
    const: dma-reset

  dma-requests:
    description: Number of peripheral request lines

  dma-channels:
    description: Number of physical channels

  '#dma-cells':
    const: 2
    description: |
      The first cell is the DMA request line number, which is also
      written to the request selector field of the channel config
      register.  The second cell is the request multiplexer value of
      the requesting peripheral, which is ignored on this SoC and
      must match the first cell.

required:
  - compatible
  - reg
  - interrupts
  - clocks
  - clock-names
  - resets
  - reset-names
  - dma-requests
  - dma-channels
  - '#dma-cells'

unevaluatedProperties: false

examples:
  - |
    dma-controller@10280000 {
        compatible = "hisilicon,hi3519dv500-edmacv310";
        reg = <0x10280000 0x1000>;
        interrupts = <0 58 4>;
        clocks = <&crg 69>, <&crg 70>;
        clock-names = "apb_pclk", "axi_aclk";
        resets = <&crg 0x2a80 0>;
        reset-names = "dma-reset";
        dma-requests = <32>;
        dma-channels = <8>;
        #dma-cells = <2>;
    };
...
```

## Documentation/devicetree/bindings/i2c/hisilicon,hi3519dv500-i2c.yaml
```yaml
# SPDX-License-Identifier: GPL-2.0-only OR BSD-2-Clause
%YAML 1.2
---
$id: http://devicetree.org/schemas/i2c/hisilicon,hi3519dv500-i2c.yaml#
$schema: http://devicetree.org/meta-schemas/core.yaml#

title: I2C controller for HiSilicon Hi3519DV500 SoC

maintainers:
  - Jun Yan <jerrysteve1101@gmail.com>

allOf:
  - $ref: /schemas/i2c/i2c-controller.yaml#

properties:
  compatible:
    enum:
      - hisilicon,hi3519dv500-i2c

  reg:
    maxItems: 1

  interrupts:
    maxItems: 1
    description:
      The interrupt of the controller. If it is not provided, the
      controller is driven in polling mode.

  clocks:
    maxItems: 1

  clock-frequency:
    description: Desired I2C bus frequency in Hz
    default: 100000

  resets:
    maxItems: 1

  reset-names:
    const: i2c_reset

  dmas:
    description:
      Optional receive and transmit DMA channels. Messages longer
      than a few bytes are served by DMA, otherwise the controller
      falls back to the FIFO interrupts.
    minItems: 2
    maxItems: 2

  dma-names:
    items:
      - const: rx
      - const: tx

required:
  - compatible
  - reg
  - clocks

unevaluatedProperties: false

examples:
  - |
    i2c@11060000 {
        compatible = "hisilicon,hi3519dv500-i2c";
        reg = <0x11060000 0x1000>;
        clocks = <&crg 50>;
        clock-frequency = <100000>;
        resets = <&crg 0x4280 0>;
        reset-names = "i2c_reset";
        dmas = <&dma 0 0>, <&dma 1 1>;
        dma-names = "rx", "tx";
        #address-cells = <1>;
        #size-cells = <0>;
    };
...
```

## Documentation/devicetree/bindings/iio/adc/hisilicon,hi3519dv500-lsadc.yaml
```yaml
# SPDX-License-Identifier: GPL-2.0-only OR BSD-2-Clause
%YAML 1.2
---
$id: http://devicetree.org/schemas/iio/adc/hisilicon,hi3519dv500-lsadc.yaml#
$schema: http://devicetree.org/meta-schemas/core.yaml#

title: HiSilicon Hi3519DV500 LSADC

maintainers:
  - Jun Yan <jerrysteve1101@gmail.com>

description:
  The Hi3519DV500 Low Speed ADC provides four 10 bit voltage input
  channels.  A conversion is started on demand and the converted
  value is reported with an interrupt.

properties:
  compatible:
    const: hisilicon,hi3519dv500-lsadc

  reg:
    maxItems: 1

  interrupts:
    maxItems: 1

  clocks:
    maxItems: 1

  clock-names:
    const: lsadc

  resets:
    maxItems: 1

  reset-names:
    const: lsadc

  vref-supply: true

  "#io-channel-cells":
    const: 1

required:
  - compatible
  - reg
  - interrupts
  - clocks
  - resets
  - vref-supply
  - "#io-channel-cells"

additionalProperties: false

examples:
  - |
    #include <dt-bindings/clock/hi3519dv500-clock.h>
    #include <dt-bindings/interrupt-controller/arm-gic.h>

    adc@11100000 {
        compatible = "hisilicon,hi3519dv500-lsadc";
        reg = <0x11100000 0x1000>;
        interrupts = <GIC_SPI 47 IRQ_TYPE_LEVEL_HIGH>;
        clocks = <&crg HI3519DV500_LSADC_CLK>;
        clock-names = "lsadc";
        resets = <&crg 0x46c0 0>;
        reset-names = "lsadc";
        vref-supply = <&ldo7>;
        #io-channel-cells = <1>;
    };
...
```

## Documentation/devicetree/bindings/iio/gyroscope/bosch,bmg160.yaml
```yaml
# SPDX-License-Identifier: (GPL-2.0-only OR BSD-2-Clause)
%YAML 1.2
---
$id: http://devicetree.org/schemas/iio/gyroscope/bosch,bmg160.yaml#
$schema: http://devicetree.org/meta-schemas/core.yaml#

title: Bosch BMG160 triaxial rotation sensor (gyroscope)

maintainers:
  - H. Nikolaus Schaller <hns@goldelico.com>

properties:
  compatible:
    oneOf:
      - enum:
          - bosch,bmg160
          - bosch,bmi055_gyro
          - bosch,bmi088_gyro
      - items:
          - const: bosch,bmx055-gyro
          - const: bosch,bmg160

  reg:
    maxItems: 1

  vdd-supply: true
  vddio-supply: true

  mount-matrix:
    description: an optional 3x3 mounting rotation matrix.

  spi-max-frequency:
    maximum: 10000000

  interrupts:
    minItems: 1
    maxItems: 2
    description:
      Should be configured with type IRQ_TYPE_EDGE_RISING or 
      IRQ_TYPE_EDGE_FALLING.
      If two interrupts are provided, expected order is INT1 and INT2.

  interrupt-names:
    minItems: 1
    maxItems: 2
    items:
      enum:
        - INT1
        - INT2

  drive-open-drain:
    type: boolean
    description:
      set if the interrupt pin(s) should be configured as
      open drain. If not set, defaults to push-pull.

required:
  - compatible
  - reg

allOf:
  - $ref: /schemas/spi/spi-peripheral-props.yaml#

unevaluatedProperties: false

examples:
  - |
    #include <dt-bindings/interrupt-controller/irq.h>
    i2c {
        #address-cells = <1>;
        #size-cells = <0>;
        gyroscope@69 {
            compatible = "bosch,bmg160";
            reg = <0x69>;
            interrupt-parent = <&gpio6>;
            interrupts = <18 IRQ_TYPE_EDGE_RISING>;
            mount-matrix = "0", "1", "0",
                           "1", "0", "0",
                           "0", "0", "1";
        };
    };
...
```
